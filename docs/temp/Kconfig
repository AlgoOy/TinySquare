## docs/temp/Kconfig
```kconfig
# Kconfig file for package TinySquare
menuconfig PKG_USING_TINYSQUARE
    bool "TinySquare: a lightweight square game engine running on Cortex-M."
    default n

if PKG_USING_TINYSQUARE

    config PKG_TINYSQUARE_PATH
        string
        default "/packages/multimedia/TinySquare"

    config TINYSQUARE_USING_INTERNEL_ARM_2D
        bool "using arm-2d inside tinysquare"
        default n

    config TINYSQUARE_USING_EXAMPLES_SNAKE
        bool "using snake example"
        default n

    choice
        prompt "Version"
        default PKG_USING_TINYSQUARE_LATEST_VERSION
        help
            Select the package version

        config PKG_USING_TINYSQUARE_V020
            bool "v0.2.0"

        config PKG_USING_TINYSQUARE_LATEST_VERSION
            bool "latest"
    endchoice

    config PKG_TINYSQUARE_VER
       string
       default "v0.2.0"    if PKG_USING_TINYSQUARE_V020
       default "latest"    if PKG_USING_TINYSQUARE_LATEST_VERSION

endif
```
